/*
 * Copyright (c) 2022 The ZMK Contributors
 *
 * SPDX-License-Identifier: MIT
 */

#include "swifty.dtsi"

/* perkey-underglow fork only — restore after cherry-pick
/ {
underglow-layer {
    compatible  = "zmk,underglow-layer";
    pixel-lookup = <5>, <4>, <3>, <2>, <1>, <0>,
                   <12>, <13>, <14>, <15>, <16>, <17>,
                   <29>, <28>, <27>, <26>, <24>, <25>,
                         <38>, <39>, <40>, <41>, <42>, <43>, <30>;
                  };
};
*/