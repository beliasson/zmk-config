/*
 * Copyright (c>, 2022 The ZMK Contributors
 *
 * SPDX-License-Identifier: MIT
 */

#include "swifty.dtsi"

&default_transform {
  col-offset = <25>;
};

/* perkey-underglow fork only — restore after cherry-pick
/ {
  underglow-layer {
    compatible  = "zmk,underglow-layer";
    pixel-lookup =  <6>, <7>, <8>, <9>, <10>, <11>,
                    <23>, <22>, <21>, <20>, <19>, <18>,
                    <32>, <33>, <34>, <35>, <37>, <36>,
                          <49>, <48>, <47>, <46>, <45>, <44>, <31>;
  };
};
*/