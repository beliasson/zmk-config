## config/boards/beliasson/swippy/board.yml
```yaml
board:
  name: swippy
  vendor: beliasson
  socs:
    - name: nrf52840
      variants:
        - name: zmk
```

## config/boards/shields/swifty/Kconfig.defconfig
```kconfig
# Copyright (c) 2022 The ZMK Contributors
# SPDX-License-Identifier: MIT

if SHIELD_SWIFTY_RIGHT

config ZMK_KEYBOARD_NAME
	default "Benes Keyboard"

config ZMK_SPLIT_ROLE_CENTRAL
	default y

config ZMK_USB
	default y

endif

if SHIELD_SWIFTY_LEFT || SHIELD_SWIFTY_RIGHT || SHIELD_SWIFTY_DONGLE

config ZMK_SPLIT
	default y

config ZMK_BLE
	default y

endif
```
